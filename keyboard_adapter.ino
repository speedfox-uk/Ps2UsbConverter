#define byte uint8_t
#include <PS2Events.h>
#include "KeyPress.h"

//Pint 2 and pin 3 work for arduino mega
#define DATA_PIN 10
#define IRQ_PIN 3 //seems to have to be pin 3. no idea why
#define MAPPED_PIN A1
#define UNMAPPED_PIN 4
#define SW1_PIN 2
#define SW2_PIN A2

/*
 * These are the maps used to turn PS/2 scan codes into USB scan codes. 
 */

char ps2_to_usb_reampped_modded_codes[] = {
0x00,
0x00, //F9
0x00,
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0x00,
0x00 //F7
};



//Try these if there is a modified marker
char ps2_to_usb_remapped_codes[] = {
0x00,
0x00, //F9
0x00,
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0x00,
0x00 //F7
};

//Try these if there is a modified marker
char ps2_to_usb_modded_codes[] = {
0x00,
0x00, //F9
0x00,
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0x00,
0x00 //F7
};


//The defautl scan code mapping. Use these if there is nothing lese to be used
char ps2_to_usb_codes[] = {
0x00,
0x42, //F9
0x00,
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0x00,
0x40 //F7
};


PS2Events input; //PS/2 input
boolean doRemap = true;

void setup() {
  pinMode(MAPPED_PIN, OUTPUT);
  pinMode(UNMAPPED_PIN, OUTPUT);
  pinMode(SW1_PIN, INPUT);
  pinMode(SW2_PIN, INPUT);  
  digitalWrite(MAPPED_PIN, doRemap ? LOW:HIGH);
  digitalWrite(UNMAPPED_PIN, !doRemap ? LOW:HIGH);
  input.begin(DATA_PIN, IRQ_PIN);  
  Serial.begin(9600);
  
  Serial.println("hi\n");
  delay(1000);

}

/**
 * The main loop. Has two distincly separate sections
 * 1.) Check remap state: checks the switches and see if remapping is reuired. If this has changed from the last itteration of the loop update the LEDS and release all of the keys. 
 * 2.) Check the PS2Events to see if there are any events that need to be passed to the USB library. If remapping is reuired check those mappings first.
 */
void loop() {  
 KeyEvent evt;
 boolean sw1 = digitalRead(SW1_PIN);
 boolean sw2 = digitalRead(SW2_PIN);
 //If both switches are in the same state we want to remap, otherwise not
 boolean swNow = sw1 == sw2;

 //remapping has been switched change the states of the LEDs
 if(swNow != doRemap){   
   doRemap = swNow;
   digitalWrite(MAPPED_PIN, doRemap ? LOW:HIGH);
   digitalWrite(UNMAPPED_PIN, !doRemap ? LOW:HIGH);
   if(doRemap)
       Serial.println("Map on\n");
   else
       Serial.println("Map off\n");
   KeyPress.allUp();//Get rid of everything after the switch to be safe.
 }
 
 if(input.eventAvailable()) {
   input.readEvent(&evt);
   Serial.print(evt.code, DEC);
   char code = 0;

   //remapping is on. Lets try those tables first
   if(doRemap){
     if(evt.mod && 0 == code)
       code = ps2_to_usb_reampped_modded_codes[evt.code];
       if(0==code)
         code = ps2_to_usb_remapped_codes[evt.code];
   }

    
   if(evt.mod && 0 == code)
     code = ps2_to_usb_modded_codes[evt.code];

   if(0==code)
     code = ps2_to_usb_codes[evt.code];
    
   if(evt.state){
     Serial.print(" DOWN");
     if(0!= code)
       KeyPress.keyDown(code);
   }
   else{
     Serial.print(" UP");
     if(0!=code)
       KeyPress.keyUp(code);
    }
        
    if(evt.mod)
        Serial.print(" Mod");
    else
        Serial.print(" nomod");
    Serial.print('\n');
  }  
  
}


